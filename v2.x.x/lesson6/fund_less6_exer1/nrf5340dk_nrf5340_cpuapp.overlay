// To get started, press Ctrl+Space to bring up the completion menu and view the available nodes.

// You can also use the buttons in the sidebar to perform actions on nodes.
// Actions currently available include:

// * Enabling / disabling the node
// * Adding the bus to a bus
// * Removing the node
// * Connecting ADC channels

// For more help, browse the DeviceTree documentation at https://docs.zephyrproject.org/latest/guides/dts/index.html
// You can also visit the nRF DeviceTree extension documentation at https://nrfconnect.github.io/vscode-nrf-connect/devicetree/nrfdevicetree.html
&i2c1 { //HH: in the 5340 the I2C device mapped to the arduino port P1.02 and P1.03 is I2C1. Otherwise we get squiggles in the def.
    tempsensor: tempsensor@4a{
        compatible = "i2c-device";
        reg = < 0x4a >; //HH: 8 bit address given in tech sheet is 0x94h - 7 bit address necessary and obtained by shifting one bit to the right getting 0x4a
        label = "TEMPSENSOR";
    };
};
